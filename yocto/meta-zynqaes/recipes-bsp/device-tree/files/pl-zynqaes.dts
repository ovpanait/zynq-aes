/*
 * CAUTION: This file is automatically generated by Xilinx.
 * Version: HSI 2018.2
 * Today is: Fri Dec  7 20:04:06 2018
 */

/dts-v1/;
/plugin/;

/ {
	fragment@0 {
		target = <&axi_dma_0>;
		__overlay__ {
			status = "okay";
		};
	};

	fragment@1 {
		target-path = "/";
		__overlay__ {
			axidmatest_1: axidmatest@1 {
				compatible ="xlnx,axi-dma-test-1.00.a";
				dmas = <&axi_dma_0 0
					&axi_dma_0 1>;
				dma-names = "axidma0", "axidma1";
			};
		};
	};

};
