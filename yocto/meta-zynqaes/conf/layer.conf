## yocto/meta-zynqaes/conf/layer.conf
```bitbake
# We have a conf and classes directory, add to BBPATH
BBPATH .= ":${LAYERDIR}"

# We have a packages directory, add to BBFILES
BBFILES += "${LAYERDIR}/recipes-*/*/*.bb"
BBFILES += "${LAYERDIR}/recipes-*/*/*.bbappend"

BBFILE_COLLECTIONS += "zynqaes"
BBFILE_PATTERN_zynqaes = "^${LAYERDIR}/"
BBFILE_PRIORITY_zynqaes = "5"

LAYERDEPENDS_zynqaes = "core"

LAYERSERIES_COMPAT_zynqaes = "rocko thud"
```
